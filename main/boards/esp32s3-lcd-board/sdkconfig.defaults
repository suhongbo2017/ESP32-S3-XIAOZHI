## main/boards/esp32s3-lcd-board/sdkconfig.defaults
```kconfig
# ESP32-S3 LCD Board (esp32s3-lcd-board)
# 使用方法: idf.py -DSDKCONFIG_DEFAULTS="sdkconfig.defaults;sdkconfig.defaults.esp32s3;main/boards/esp32s3-lcd-board/sdkconfig.defaults" build

CONFIG_BOARD_TYPE_ESP32S3_LCD_BOARD=y
CONFIG_LCD_ST7735_128X160=y

# 本板 PSRAM 为 ESP-PSRAM64H (Quad 4线)，默认 esp32s3 配置为 OCT(8线)，必须覆盖
CONFIG_SPIRAM=y
CONFIG_SPIRAM_MODE_QUAD=y
# CONFIG_SPIRAM_MODE_OCT is not set
CONFIG_SPIRAM_SPEED_80M=y
CONFIG_SPIRAM_MALLOC_ALWAYSINTERNAL=2048
CONFIG_SPIRAM_MALLOC_RESERVE_INTERNAL=98304
CONFIG_SPIRAM_MEMTEST=n
CONFIG_MBEDTLS_EXTERNAL_MEM_ALLOC=y
```
